#include <ArduinoJson.h>
#include <PubSubClient.h>
#include "WiFi.h"

// Motor / engine A
const int enA = 32; //PWM pin for engine A.
const int in1 = 23; //Input 1
const int in2 = 22; //Input 2.

// Motor / engine B
const int enB = 33; //PWM pin for engine B.
const int in3 = 18; //Input 3.
const int in4 = 19; //Input 4.

// PWM settings
const int frequency = 30000; // 30kHz.
const int pwmChannelEnA = 0; // Channel to generate the PWM pin for motor A.
const int pwmChannelEnB = 1; // Channel to generate the PWM pin for motor B.
const int resolution = 8; // Resolution = 2^8 = 0 - 255.
int dutyCycle = 255; // Duty Cycle is initialized on the maximum speed.

// WiFi and MTQQ broker stuff
const char* ssid = "PROFTAAKGROEPB1";
const char* password = "administrator";
const char* mqtt_broker = "192.168.1.100";
const char* mqtt_topic = "PROFTAAKGROEPB1";
const char* mqtt_user = "B1";
const char* mqtt_password = "PROFTAAKGROEPB1";
WiFiClient wifiClient; // WifiClient initializing.
PubSubClient pubSubClient("", 0, wifiClient); // WifiClient initializing. 

void setup() {
  // Open for communication.
  Serial.begin(115200);
  configurePins();
  configureWiFi();
}

// Main loop.
void loop() {
  //motorTest();
  pubSubLoop();
  delay(100);
}

void motorTest() { 
  controlEngine(dutyCycle, enA);
  controlEngine(dutyCycle, enB);
  dutyCycle=255;
}

void configurePins() { 
   // Set the pinmode for the motor pins to "OUTPUT".
  pinMode(in1, OUTPUT);
  pinMode(in2, OUTPUT);
  pinMode(enA, OUTPUT);
  pinMode(in3, OUTPUT);
  pinMode(in4, OUTPUT);
  pinMode(enB, OUTPUT);

  // This code sets the PWM signal specifications.
  ledcSetup(pwmChannelEnA, frequency, resolution);
  ledcSetup(pwmChannelEnB, frequency, resolution);

  // Bind the channel that creates the signal to the corresponding PWM pin (in this case engine A and engine B).
  ledcAttachPin(enA, pwmChannelEnA);
  ledcAttachPin(enB, pwmChannelEnB);
}

void configureWiFi() {   
  WiFi.mode(WIFI_STA);
  WiFi.disconnect();
  WiFi.begin(ssid, password);
  Serial.println("Connecting to: "+String(ssid)+"with password: "+String(password));
//  WiFi.setSleep(false);

  while (WiFi.status() != WL_CONNECTED) {
    delay(500);
    Serial.println("Connecting...");
  }
  Serial.println("Connected, sending local IP now.");
  delay(2000);
  Serial.println(WiFi.localIP());
}

// Send a PWM signal over the engine pin, either "enA" or "enB", with a corresponding dutyCycle, generated by a pwmChannel "pwmChannelEnA" or "pwmChannelEnB".
void controlEngine(int dutyCycle, int motor) {
  int pwmChannel = -1;
  int inputA = -1;
  int inputB = -1;

  if (motor == enA) {
    pwmChannel = pwmChannelEnA;
    inputA = in1;
    inputB = in2;
  }

  else if (motor == enB) {
    pwmChannel = pwmChannelEnB;
    inputA = in3;
    inputB = in4;
  }

  else {
    throw "Invalid motorPin entered! Must correspond to enA or enB!";
  }

  if (motor == enA || motor == enB) {
    ledcWrite(pwmChannel, abs(dutyCycle));
    if (dutyCycle > 0) {
      digitalWrite(inputB, LOW);
      digitalWrite(inputA, HIGH);
    }
    else if (dutyCycle < 0) {
      digitalWrite(inputA, LOW);
      digitalWrite(inputB, HIGH);
    }
    else {
      digitalWrite(inputA, LOW);
      digitalWrite(inputB, LOW);
    }
  }
}

//PubSub communication code begin 
void pubSubLoop() {
  if (WiFi.status() == WL_CONNECTED)
    if (!pubSubClient.connected())
      pubSubClientConnect();
    else
      pubSubClient.loop();
  else
    Serial.println("No WiFi connection with: " + String(ssid));
}

void pubSubClientConnect() {
  pubSubClient.setClient(wifiClient);
  pubSubClient.setServer(mqtt_broker, 1883);

  String clientID = "CAR-"+String(random(0xffff), HEX);
  clientID += String(random(0xffff), HEX);
  clientID += '-';
  clientID += String((uint32_t)ESP.getEfuseMac(), HEX);

  if (pubSubClient.connect(clientID.c_str(), mqtt_user, mqtt_password)) {
  pubSubClient.subscribe(mqtt_topic);
    pubSubClient.setCallback(pubSubClientCallback);
  }
  else delay(2000);
  }

void pubSubClientCallback(char* topic, byte* payload, unsigned int length) {
  if ( 0 == strcmp(topic, mqtt_topic) ) {
    Serial.println("Received something");
    DynamicJsonDocument dynamicJsonDocument(1024);
    DeserializationError error = deserializeJson(dynamicJsonDocument, payload);
    if ( !error ) {
      JsonVariant msg = dynamicJsonDocument["JSONFILE"];
      if (!msg.isNull()) {
        int vehicle = msg["Vehicle"];
        int dutyCycleL = msg["DutyCycleL"]; 
        int dutyCycleR = msg["DutyCycleR"];
        Serial.println("Received: Vehicle: "+String(vehicle)+" Dutycycle for left engine: "+String(dutyCycleL)+" DutyCycleR: "+String(dutyCycleR));
        controlEngine(dutyCycleL, enA);
        controlEngine(dutyCycleR, enB);
      }
      else Serial.println("Message is null");
    }
    else Serial.println(error.c_str()); 
  }
}
//PubSub communication code end 
