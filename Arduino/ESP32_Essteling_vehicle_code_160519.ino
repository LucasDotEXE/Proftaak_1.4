// Motor / engine A
const int enA = 32; //PWM pin for engine A.
const int in1 = 23; //Input 1
const int in2 = 22; //Input 2.

// Motor / engine B
const int enB = 33; //PWM pin for engine B.
const int in3 = 18; //Input 3.
const int in4 = 19; //Input 4.

// PWM settings
const int frequency = 30000; // 30kHz.
const int pwmChannelEnA = 0; // Channel to generate the PWM pin for motor A.
const int pwmChannelEnB = 1; // Channel to generate the PWM pin for motor B.
const int resolution = 8; // Resolution = 2^8 = 0 - 255.
int dutyCycle = 255; // Duty Cycle is initialized on the maximum speed.


void setup() {
  // Set the pinmode for the motor pins to "OUTPUT".
  pinMode(in1, OUTPUT);
  pinMode(in2, OUTPUT);
  pinMode(enA, OUTPUT);
  pinMode(in3, OUTPUT);
  pinMode(in4, OUTPUT);
  pinMode(enB, OUTPUT);

  // This code sets the PWM signal specifications.
  ledcSetup(pwmChannelEnA, frequency, resolution);
  ledcSetup(pwmChannelEnB, frequency, resolution);

  // Bind the channel that creates the signal to the corresponding PWM pin (in this case engine A and engine B).
  ledcAttachPin(enA, pwmChannelEnA);
  ledcAttachPin(enB, pwmChannelEnB);

  // Open for communication.
  Serial.begin(115200);
}

// Send a PWM signal over the engine pin, either "enA" or "enB", with a corresponding dutyCycle, generated by a pwmChannel "pwmChannelEnA" or "pwmChannelEnB".
void controlEngine(int dutyCycle, int motor) {
  int pwmChannel = -1;
  int inputA = -1;
  int inputB = -1;

  if (motor == enA) {
    pwmChannel = pwmChannelEnA;
    inputA = in1;
    inputB = in2;
  }

  else if (motor == enB) {
    pwmChannel = pwmChannelEnB;
    inputA = in3;
    inputB = in4;
  }

  else {
    throw "Invalid motorPin entered! Must correspond to enA or enB!";
  }

  if (motor == enA || motor == enB) {
    ledcWrite(pwmChannel, abs(dutyCycle));
    if (dutyCycle > 0) {
      digitalWrite(inputB, LOW);
      digitalWrite(inputA, HIGH);
    }
    else if (dutyCycle < 0) {
      digitalWrite(inputA, LOW);
      digitalWrite(inputB, HIGH);
    }
    else {
      digitalWrite(inputA, LOW);
      digitalWrite(inputB, LOW);
    }
  }
}

// Main loop.
void loop() {
  controlEngine(dutyCycle, enA);
  controlEngine(dutyCycle, enB);
  dutyCycle = 255;
  delay(100);
}
